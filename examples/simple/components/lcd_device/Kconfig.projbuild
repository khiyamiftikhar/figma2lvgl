## examples/simple/components/lcd_device/Kconfig.projbuild
```kconfig
menu "GUI Configuration"

choice LCD_CONTROLLER
    prompt "LCD controller model"
    default LCD_CONTROLLER_SSD1306

    config LCD_CONTROLLER_SSD1306
        bool "SSD1306 (I2C OLED)"

    config LCD_CONTROLLER_SH1107
        bool "SH1107 (I2C OLED)"

    config LCD_CONTROLLER_ILI9486
        bool "ILI9486 (SPI TFT)"

endchoice


# ----------------------------------------------------------------
# SSD1306 Resolution Selection
# ----------------------------------------------------------------
choice SSD1306_HEIGHT_SEL
    prompt "SSD1306 Height"
    depends on LCD_CONTROLLER_SSD1306
    default SSD1306_HEIGHT_32

    config SSD1306_HEIGHT_32
        bool "128x32"

    config SSD1306_HEIGHT_64
        bool "128x64"
endchoice


# ----------------------------------------------------------------
# Global Resolution Values (Single Interface to C Code)
# ----------------------------------------------------------------
config LCD_H_RES
    int
    default 128 if LCD_CONTROLLER_SSD1306
    default 64  if LCD_CONTROLLER_SH1107
    default 320 if LCD_CONTROLLER_ILI9486

config LCD_V_RES
    int
    default 32  if SSD1306_HEIGHT_32
    default 64  if SSD1306_HEIGHT_64
    default 128 if LCD_CONTROLLER_SH1107
    default 480 if LCD_CONTROLLER_ILI9486

endmenu
```
