## examples/espidf/ili9486/sdkconfig.defaults
```kconfig
CONFIG_LCD_CONTROLLER_ILI9486=y

CONFIG_ILI9486_PIN_MOSI=23
CONFIG_ILI9486_PIN_MISO=19
CONFIG_ILI9486_PIN_CLK=18
CONFIG_ILI9486_PIN_CS=5
CONFIG_ILI9486_PIN_DC=21
CONFIG_ILI9486_PIN_RST=22

CONFIG_LCD_H_RES=320
CONFIG_LCD_V_RES=480


CONFIG_XPT2046_Z_THRESHOLD=300
```
